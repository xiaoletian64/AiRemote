## esp32-bridge/sdkconfig.defaults
```kconfig
# ============================================================================
# remote_bridge - 默认 sdkconfig
# BLE Central 收小米遥控器 → USB HID 输出到 PC
# ============================================================================

# --- 目标芯片 ---
CONFIG_IDF_TARGET="esp32s3"

# --- 分区表 ---
CONFIG_PARTITION_TABLE_CUSTOM=y
CONFIG_PARTITION_TABLE_CUSTOM_FILENAME="partitions.csv"

# --- 控制台走 UART0，USB-OTG 让给 TinyUSB HID ---
CONFIG_ESP_CONSOLE_UART_DEFAULT=y
CONFIG_ESP_CONSOLE_UART_NUM=0
CONFIG_ESP_CONSOLE_SECONDARY_USB_SERIAL_JTAG=y

# --- 蓝牙：Bluedroid + GATT Client + SMP 配对（Central/Host 角色） ---
CONFIG_BT_ENABLED=y
CONFIG_BT_BLUEDROID_ENABLED=y
CONFIG_BT_NIMBLE_ENABLED=n
CONFIG_BT_BLE_42_FEATURES_SUPPORTED=y
CONFIG_BT_BLE_SMP_ENABLE=y
# GATT Client（Central 角色，必需）
CONFIG_BT_GATTC_ENABLE=y
CONFIG_BT_GATTC_CONNECT_RETRY_COUNT=3
# GATT Server 暂时不用（HID Host 直接走 GATTC 收 notification 解析）
# CONFIG_BT_GATTS_ENABLE=n
# CONFIG_BT_HID_DEVICE_ENABLED=n
# 多连接
CONFIG_BT_ACL_CONNECTIONS=4
CONFIG_BT_BLE_42_FEATURES_SUPPORTED=y
# Bond 存储
CONFIG_BT_NIMBLE_MAX_BONDS=4

# --- TinyUSB（USB-OTG GPIO19/20，HID 输出端）---
CONFIG_TINYUSB=y
CONFIG_TINYUSB_HID_ENABLED=y
CONFIG_TINYUSB_TASK_STACK_SIZE=4096

# --- Flash 8MB ---
CONFIG_ESPTOOLPY_FLASHSIZE_8MB=y
CONFIG_ESPTOOLPY_FLASHSIZE="8MB"

# --- 系统栈 ---
CONFIG_ESP_MAIN_TASK_STACK_SIZE=8192
CONFIG_ESP_SYSTEM_HW_PCNU=y
```
